## mqtt_VFE_Provisioning/main/Kconfig.projbuild
```kconfig
menu "Example Configuration"

config WEB_SERVER
        string "Web Server"
        default "cloud.bestechnology.it"

config WEB_URL
        string "Web Url"
        default "https://cloud.bestechnology.it/api/device/connected"

config WEB_PORT
        string "Web Server Port"
        default "80"

config ESP_WIFI_SSID
        string "WiFi SSID"
        default "myssid"
        help
            SSID (network name) to connect to.

config ESP_WIFI_PASSWORD
        string "WiFi Password"
        default "mypassword"
        help
            WiFi password (WPA or WPA2) to use.

config ESP_MAXIMUM_RETRY
        int "Maximum retry"
        default 10
        help
            Set the Maximum retry to avoid station reconnecting to the AP unlimited when the AP is really inexistent.

config GATEWAY_ESSID
    string "Gateway ESSID"
        default "Gateway ESSID"
        help
            Gateway ESSID.

config GATEWAY_PASSWORD
    string "Gateway password"
        default "GWPASS"
        help
            Gateway password.

config MESH_ID
    string "Mesh ID"
        default "123456"
        help
            Mesh network identification, Nodes with the same mesh ID can
            communicate with each other.

config MESH_PASSWORD
    string "Mesh Password"
    default "MESH_PASSWORD"
    help
        Mesh AP password. Password length must be 8 bits smaller than 64 bits,Set to null to not encrypt

config MQTT_URL
    string "MQTT broker URL"
    default "mqtt://192.168.1.208:1883"
    help
        URL of the broker to connect to

config DEVICE_VERSION
    string "Device version"
    default "0.0.1"
    help
        Config device version

config FIRMWARE_UPGRADE_URL
    string "Firmware upgrade url endpoint"
    default "http://192.168.0.3:8070/hello-world.bin"
    help
        URL of server which hosts the firmware image.

endmenu
```

## mqtt_VFE_multi/main/Kconfig.projbuild
```kconfig
menu "Example Configuration"

config ROUTER_SSID
    string "Router SSID"
        default "esp-liyin"
        help
            Router SSID.

config ROUTER_PASSWORD
    string "Router password"
        default "espressif"
        help
            Router password.

config MESH_ID
    string "Mesh ID"
        default "123456"
        help
            Mesh network identification, Nodes with the same mesh ID can
            communicate with each other.

config MESH_PASSWORD
    string "Mesh Password"
    default "MESH_PASSWORD"
    help
        Mesh AP password. Password length must be 8 bits smaller than 64 bits,Set to null to not encrypt

config MQTT_URL
    string "MQTT broker URL"
    default "mqtt://192.168.1.208:1883"
    help
        URL of the broker to connect to

config DEVICE_VERSION
    string "Device version"
    default "0.0.1"
    help
        Config device version

config FIRMWARE_UPGRADE_URL
    string "Firmware upgrade url endpoint"
    default "http://192.168.0.3:8070/hello-world.bin"
    help
        URL of server which hosts the firmware image.


endmenu
```
